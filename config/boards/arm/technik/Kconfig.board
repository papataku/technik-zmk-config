## config/boards/arm/technik/Kconfig.board
```kconfig
# Blank Slate board configuration

# Copyright (c) 2021 Pete Johanson
# SPDX-License-Identifier: MIT

config BOARD_TECHNIK
	bool "boardsource Tecknik"
	imply ZMK_PM_SOFT_OFF
	depends on SOC_NRF52840_QIAA
```

## config/boards/arm/technik/Kconfig.defconfig
```kconfig
# Copyright (c) 2020 Pete Johanson
# SPDX-License-Identifier: MIT

if BOARD_TECHNIK

config BOARD
	default "boardsource_Technik"

config ZMK_KEYBOARD_NAME
	default "Technik BLE"

if USB

config USB_NRFX
	default y

config USB_DEVICE_STACK
	default y

endif # USB

config BT_CTLR
	default BT

config ZMK_BLE
	default y

config ZMK_USB
	default y

config ZMK_STATUS_LED
    default y

endif # BOARD_TECHNIK
```
